# file: blink_IO.ioc
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Mcu.Family=STM32F4
Mcu.Name=STM32F401R(B-C)Tx
Mcu.Package=LQFP64
NVIC.PriorityGroup=NVIC_PRIORITYGROUP_4
PA13.Mode=Serial_Wire
PA13.Signal=SYS_JTMS-SWDIO
PA14.Mode=Serial_Wire
PA14.Signal=SYS_JTCK-SWCLK
PH0\ -\ OSC_IN.Mode=HSE-External-Oscillator
PH0\ -\ OSC_IN.Signal=RCC_OSC_IN
PH1\ -\ OSC_OUT.Mode=HSE-External-Oscillator
PH1\ -\ OSC_OUT.Signal=RCC_OSC_OUT
ProjectManager.HeapSize=0x200
ProjectManager.StackSize=0x400
ProjectManager.TargetToolchain=STM32CubeIDE
RCC.48MHZClocksFreq_Value=20480000
RCC.AHBFreq_Value=16000000
RCC.APB1Freq_Value=16000000
RCC.APB1TimFreq_Value=16000000
RCC.APB2Freq_Value=16000000
RCC.APB2TimFreq_Value=16000000
RCC.CortexFreq_Value=16000000
RCC.HCLKFreq_Value=16000000
RCC.HSE_VALUE=25000000
RCC.HSI_VALUE=16000000
RCC.LSE_VALUE=32768
RCC.PLLM=25
RCC.PLLN=128
RCC.SYSCLKFreq_VALUE=16000000
RCC.VCOOutputFreq_Value=81920000
board=custom

// file: Core/Src/main.c
/* USER CODE BEGIN Header */
/**
  ******************************************************************************
  * @file           : main.c
  * @brief          : Main program body
  ******************************************************************************
  * @attention
  *
  * Copyright (c) 2025 STMicroelectronics.
  * All rights reserved.
  *
  * This software is licensed under terms that can be found in the LICENSE file
  * in the root directory of this software component.
  * If no LICENSE file comes with this software, it is provided AS-IS.
  *
  ******************************************************************************
  */
/* USER CODE END Header */
#include "main.h"

void SystemClock_Config(void);
static void MX_GPIO_Init(void);
/* USER CODE BEGIN PFP */
//void Seg7_Print(uint8_t num);

void USART1_sendchar(uint8_t c);
void UART1_SendString (char *string);
uint8_t UART1_GetChar(void);

/* USER CODE END PFP */

/* USER CODE BEGIN 0 */
unsigned char seg_code[10]={0xC0,0xF9,0xA4,0xB0,0x99,0x92,0x82,0xF8,0x80,0x90};// nối dương chung, mã có sẵn.
unsigned int count = 0;
uint8_t data_receive;
/* USER CODE END 0 */

int main(void)
{

  /* MCU Configuration--------------------------------------------------------*/

  /* Reset of all peripherals, Initializes the Flash interface and the Systick. */
  HAL_Init();

  /* Configure the system clock */
  SystemClock_Config();

  /* Initialize all configured peripherals */
  MX_GPIO_Init();
  /* USER CODE BEGIN 2 */

  // cấu hình cho đèn LED
  RCC->AHB1ENR |= (1 << 2); //provide clk for GPIO c13 (port C)

  GPIOC->MODER |= (1 << (13 * 2)); //config general output state (01) for LED, MODER13
  GPIOC->OTYPER =  0x0000; //output type (open drain(0xffff) or push pull(0x0000))
  // initial speed to very high (11)
  GPIOC->OSPEEDR |= (3 << (2*13));     //bit 26,27

   //cấu hình cho nút ấn B3 (interupt)
  RCC->APB2ENR |= ( 1 << 14); //config clk cho ngoại vi
  RCC->AHB1ENR |= ( 1 << 1);  // config clk for b3 (port B)

  GPIOB->MODER &= ~( 3 << (2*3)); // input state for button, MODER3

  GPIOB->PUPDR |= ( 1 << 2*3); // điện trở kéo lên.
  // initial speed to very high (11)
  GPIOB->OSPEEDR |= ( 3 << 2*3); //bit 6,7

  //cấu hình interupt B3
  SYSCFG->EXTICR[0] |= (1 << 4*3); //bật ngắt ngoài cho PB3, 1 là trạng thái 0001 shift qua 3(do PB3) và 4 là vì ô nhớ có 4bit.
  EXTI->IMR |= (1 << 3); // bật mask cho interupt ở PB3, chỉ là điều kiện cần =))

  EXTI->FTSR |= (1 << 3); // falling edge lên 1 do dùng điện trở kéo lên.
  EXTI->RTSR &= ~(1 << 3); // rising edge thành 0 ( nếu cả 2 là 11 thì là toggle )

  NVIC->ISER[0] |= (1<<9); // vô datasheet tìm table 61

  // cấu hình cho nút ấn B2 (interupt)
  RCC->APB2ENR |= ( 1 << 14); //config clk cho ngoại vi
  RCC->AHB1ENR |= ( 1 << 1);  // config clk for b3 (port B)

  GPIOB->MODER &= ~( 3 << (2*2)); // input state for button, MODER2

  GPIOB->PUPDR |= ( 1 << 2*2); // điện trở kéo lên.
  // initial speed to very high (11)
  GPIOB->OSPEEDR |= ( 3 << 2*2); //bit 6,7

  //cấu hình interupt B2
  SYSCFG->EXTICR[0] |= (1 << 4*2); //bật ngắt ngoài cho PB3, 1 là trạng thái 0001 shift qua 3(do PB3) và 4 là vì ô nhớ có 4bit.
  EXTI->IMR |= (1 << 2); // bật mask cho interupt ở PB3, chỉ là điều kiện cần =))

  EXTI->FTSR |= (1 << 2); // falling edge lên 1 do dùng điện trở kéo lên.
  EXTI->RTSR &= ~(1 << 2); // rising edge thành 0 ( nếu cả 2 là 11 thì là toggle )

  NVIC->ISER[0] |= (1<<8); // vô datasheet tìm table 61

   //LED 7 đoạn
  RCC->AHB1ENR |= (1 << 0);
  GPIOA->MODER &= ~(0x3FFF);     // clear PA0..PA6
  GPIOA->MODER |=  (0x1555);     // set to output mode

  // Output push-pull
  GPIOA->OTYPER &= ~(0x7F);
  // Low speed (cho LED, không cần nhanh)
  GPIOA->OSPEEDR &= ~(0x3FFF);
  // No pull-up, no pull-down
  GPIOA->PUPDR &= ~(0x3FFF);

  // 1. Enable the USART CLOCK and GPIO CLOCK
	RCC->APB2ENR |= (1<<4); // Enable UART1 CLOCK
	RCC->AHB1ENR |= (1<<0); // Enable GPIOA CLOCK
  // 2. Configure the USART PINs for Alternate Function
	GPIOA->MODER |= (2 << (2*9)); // Alternate Function for Pin PA2
	GPIOA->MODER |= (2 << (2*10)); // Alternate Function for Pin PA3

	GPIOA->OSPEEDR |= (3 << (2*9))|(3 << (2*10)); // => High speed for PIN PA9 and PIN PA10

	GPIOA->AFR[1] |= (7<<(4*1)); //  AF7 Alternate function for UART1 at Pin PA9 (trang 286/1751)
	GPIOA->AFR[1] |= (7<< (4*2)); // AF7 Alternate function for UART1 at Pin PA10 (trang 286/1751)
  // 3. Enable the USART by writing the UE bit in USART_CR1 register to 1
	USART1->CR1 = 0x00 ; // clear all
	USART1->CR1 |= (1<<13) ; // UE = 1 ... Enable USART
  // 4. Program the M bit in USART_CR1 to define the word length
	USART1->CR1 &= ~(1<<12); // M=0; 8 bit word length
	//5. Select the desired baudrate using USART_BRR register
	USART1->BRR = (6<<0)|(17<<4); // Baud rate 57600 , PCLK1 at 16MHz
	// 6. Enable the Transmitter/Receiver by Setting the TE and RE bits in USART_CR1 Register
	USART1->CR1 |= (1<<2); // RE=1 Enable Receiver
	USART1->CR1 |= (1<<3); // TE=1 Enable Transmitter

  /* USER CODE END 2 */

  /* Infinite loop */
  while (1) {

    /* USER CODE BEGIN 3 */
	  data_receive = UART1_GetChar();

	  count = data_receive - '0';  //chuyển từ ASCII qua số nguyên

	  Seg7_Print(count);

	  HAL_Delay(200);

//	 Seg7_Print(count);
//	 HAL_Delay(500);
//
//	 if ( count == 0 || count == 9 ) {
//		 GPIOC->BSRR |= (1 << 13); // MỞ ĐÈN !!!
//	 }
//	 else {
//
//		 GPIOC->BSRR |= (1 << (13+16)); // TẮT ĐÈN !
//	 }

//	  for(int i = 0; i < 10;i++){
//		  Seg7_Print(i);
//		  HAL_Delay(1000);
//	  }

  }
  /* USER CODE END 3 */
}

void SystemClock_Config(void)
{
  RCC_OscInitTypeDef RCC_OscInitStruct = {0};
  RCC_ClkInitTypeDef RCC_ClkInitStruct = {0};

  /** Configure the main internal regulator output voltage
  */
  __HAL_RCC_PWR_CLK_ENABLE();
  __HAL_PWR_VOLTAGESCALING_CONFIG(PWR_REGULATOR_VOLTAGE_SCALE2);

  /** Initializes the RCC Oscillators according to the specified parameters
  * in the RCC_OscInitTypeDef structure.
  */
  RCC_OscInitStruct.OscillatorType = RCC_OSCILLATORTYPE_HSI;
  RCC_OscInitStruct.HSIState = RCC_HSI_ON;
  RCC_OscInitStruct.HSICalibrationValue = RCC_HSICALIBRATION_DEFAULT;
  RCC_OscInitStruct.PLL.PLLState = RCC_PLL_NONE;
  if (HAL_RCC_OscConfig(&RCC_OscInitStruct) != HAL_OK)
  {
    Error_Handler();
  }

  /** Initializes the CPU, AHB and APB buses clocks
  */
  RCC_ClkInitStruct.ClockType = RCC_CLOCKTYPE_HCLK|RCC_CLOCKTYPE_SYSCLK
                              |RCC_CLOCKTYPE_PCLK1|RCC_CLOCKTYPE_PCLK2;
  RCC_ClkInitStruct.SYSCLKSource = RCC_SYSCLKSOURCE_HSI;
  RCC_ClkInitStruct.AHBCLKDivider = RCC_SYSCLK_DIV1;
  RCC_ClkInitStruct.APB1CLKDivider = RCC_HCLK_DIV1;
  RCC_ClkInitStruct.APB2CLKDivider = RCC_HCLK_DIV1;

  if (HAL_RCC_ClockConfig(&RCC_ClkInitStruct, FLASH_LATENCY_0) != HAL_OK)
  {
    Error_Handler();
  }
}

static void MX_GPIO_Init(void)
{

  /* GPIO Ports Clock Enable */
  __HAL_RCC_GPIOH_CLK_ENABLE();
  __HAL_RCC_GPIOA_CLK_ENABLE();

}

/* USER CODE BEGIN 4 */
void EXTI3_IRQHandler (void) { // dùng EXTI3 nên là ye
    // place your code
	if (EXTI->PR & (1 << 3)) { // 12.3.6 trong datasheet
	        EXTI->PR |= (1 << 3);  // xóa cờ pending ( xóa là ghi 1 vô bit đó)
	        count = count + 1;
	        if ( count > 9){
	        	count = 9;
	        }
	    }
}

void EXTI2_IRQHandler (void) { // dùng EXTI2 nên là ye
    // place your code
	if (EXTI->PR & (1 << 2)) { // 12.3.6 trong datasheet
	        EXTI->PR |= (1 << 2);  // xóa cờ pending ( xóa là ghi 1 vô bit đó)
	        count = count - 1;
	        if ( count < 0){
	        	count = 0;
	        }
	    }
}

void Seg7_Print(uint8_t num) {  //convert từ số thập phân sang LED 7 đoạn

    uint8_t code = seg_code[num];

    GPIOA->ODR &= ~(0x7F); // Clear 7 bit (PA0..PA6) ( clear về 0)
    // Ghi mã segment
    GPIOA->ODR |= (code & 0x7F);//filter ra
}

//UART
void USART1_sendchar(uint8_t c){
	USART1->DR = c; // load data into DR register
	while (!(USART1->SR&(1<<6)));// Wait for TC to SET .. This indicates that the data has been transmitted
}

void UART1_SendString (char *string) {
	while(*string) USART1_sendchar(*string++);
}

uint8_t UART1_GetChar(void){
	uint8_t temp;
	while(!(USART1->SR&(1<<5))); // wait for RXNE bit to set
	temp = USART1->DR; // Read the data . This clears the RXNE also
	return temp;
}
/* USER CODE END 4 */

void Error_Handler(void)
{
  __disable_irq();
  while (1)
  {
  }
}
